## Kconfig
```kconfig
menu "Toolchain Configuration"
config CROSS_COMPILE_ENABLED
    bool "Enable cross compilation"
    default y
    help
      Enable cross-compilation toolchain configuration

config CROSS_COMPILER_SYSROOT_PATH
    depends on CROSS_COMPILE_ENABLED
    string "Sysroot path"
    default ""
    help
      Path to the sysroot directory for cross-compilation

config CROSS_COMPILER_C_PATH
    depends on CROSS_COMPILE_ENABLED
    string "C compiler path"
    default ""
    help
      Full path to the C cross-compiler

config CROSS_COMPILER_CPP_PATH
    depends on CROSS_COMPILE_ENABLED
    string "C++ compiler path"
    default ""
    help
      Full path to the C++ cross-compiler
endmenu

menu "Output Configuration"
config BUILD_DIR_NAME
    string "Build directory name (e.g. build or build_xx)"
    default "build"
    help
      Name of the build directory (e.g. build or build_xx)
endmenu
```

## src/hal/Kconfig
```kconfig
menu "hal interfaces setting"
config USE_V4L2
    bool "enable v4l2 interface"
    default "n"
    help
      to do

config USE_DRM
    bool "enable drm interface"
    default "n"
    help
      to do

config USE_FBDEV
    bool "enable fbdev interface"
    default "n"
    help
      to do

config USE_UART
    bool "enable uart interface"
    default "n"
    help
      to do

config USE_EVDEV
    bool "enable evdev interface"
    default "n"
    help
      to do
endmenu
```

## src/modules/Kconfig
```kconfig
menu "Module Configuration"
menu "Module GUI"
config USE_MODULE_GUI
    bool "enable gui module"
    default "n"
    help
    to do
endmenu

menu "Module AIchat"
config USE_MODULE_AICHAT
    bool "enable aichat module"
    default "n"
    help
    to do
endmenu

menu "Module VISION"
config USE_MODULE_VISION
    bool "enable vison module"
    default "n"
    help
    to do
endmenu
endmenu
```
